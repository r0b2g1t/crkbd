## boards/shields/crkbd/Kconfig.shield
```kconfig
# Copyright (c) 2020 Pete Johanson
# SPDX-License-Identifier: MIT

config SHIELD_CRKBD_LEFT
	def_bool $(shields_list_contains,crkbd_left)

config SHIELD_CRKBD_RIGHT
	def_bool $(shields_list_contains,crkbd_right)
```

## west.yml
```yaml
manifest:
  default:
    revision: v0.1
  remotes:
    - name: zmkfirmware
      url-base: https://github.com/zmkfirmware
  projects:
    - name: zmk
      remote: zmkfirmware
      import: app/west.yml
  self:
    path: config
```
